## boards/arm/jing34/Kconfig
```kconfig
config BOARD_ENABLE_DCDC
    bool "Enable DCDC mode"
    select SOC_DCDC_NRF52X
    default y
    depends on (BOARD_JING34)

config BOARD_NRFMICRO_CHARGER
    bool "Enable battery charger"
    default y
    depends on (BOARD_JING34)

# Turn on logging, and set ZMK logging to debug output
# CONFIG_ZMK_USB_LOGGING=n
```

## boards/arm/jing34/Kconfig.board
```kconfig
# nrfmicro board configuration

# Copyright (c) 2020 The ZMK Contributors
# SPDX-License-Identifier: MIT

config BOARD_JING34
    bool "jing_34"
    depends on SOC_NRF52833_QIAA
```

## boards/arm/jing34/Kconfig.defconfig
```kconfig
# Electronut Labs Papyr board configuration

# Copyright (c) 2020 The ZMK Contributors
# SPDX-License-Identifier: MIT

if BOARD_JING34

config ZMK_KEYBOARD_NAME
    default "jing34"

if USB_DEVICE_STACK

config USB_NRFX
    default y

endif # USB_DEVICE_STACK

config BT_CTLR
    default BT

endif # BOARD_JING34
```

## boards/arm/jing34/jing34_defconfig
```kconfig
# SPDX-License-Identifier: MIT

CONFIG_SOC_SERIES_NRF52X=y
CONFIG_SOC_NRF52833_QIAA=y
CONFIG_BOARD_JING34=y

# Enable MPU
CONFIG_ARM_MPU=y

CONFIG_PINCTRL=y
CONFIG_GPIO=y
CONFIG_SPI=y

CONFIG_USE_DT_CODE_PARTITION=y
CONFIG_BUILD_OUTPUT_UF2=y
CONFIG_BUILD_OUTPUT_UF2_FAMILY_ID="0xada00000"

CONFIG_MPU_ALLOW_FLASH_WRITE=y
CONFIG_NVS=y
CONFIG_SETTINGS_NVS=y
CONFIG_FLASH=y
CONFIG_FLASH_PAGE_LAYOUT=y
CONFIG_FLASH_MAP=y
CONFIG_CLOCK_CONTROL_NRF=y
CONFIG_CLOCK_CONTROL_NRF_K32SRC_RC=y

CONFIG_ZMK_USB=y
CONFIG_ZMK_BLE=y

CONFIG_ZMK_SLEEP=y
CONFIG_ZMK_IDLE_SLEEP_TIMEOUT=900000

# Enable soft off
CONFIG_ZMK_PM_SOFT_OFF=y

# Battery reporting
CONFIG_ZMK_BATTERY_REPORTING=y
```
